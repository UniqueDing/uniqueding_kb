## boards/arm/charybdis_cirque/Kconfig.board
```kconfig
config BOARD_CHARYBDIS_CIRQUE_LEFT
    bool "charybdis_cirque left"
    depends on SOC_NRF52840_QIAA

config BOARD_CHARYBDIS_CIRQUE_RIGHT
    bool "charybdis_cirque right"
    depends on SOC_NRF52840_QIAA
    select ZMK_MOUSE
    select pinctrl
    select INPUT
    select INPUT_PIXART_PMW3360
```

## boards/arm/charybdis_cirque/Kconfig.defconfig
```kconfig
if BOARD_CHARYBDIS_CIRQUE_RIGHT
    config ZMK_KEYBOARD_NAME
        default "charybdis"

    config ZMK_SPLIT_BLE_ROLE_CENTRAL
        default y
endif

if BOARD_CHARYBDIS_CIRQUE_LEFT || BOARD_CHARYBDIS_CIRQUE_RIGHT
  config BOARD
    default "charybdis_cirque"

  config BOARD_ENABLE_DCDC
    bool "Enable DCDC mode"
    select SOC_DCDC_NRF52X
    default y

  config BOARD_ENABLE_DCDC_HV
    bool "Enable High Voltage DCDC converter"
    default y
    select SOC_DCDC_NRF52X_HV
    depends on (BOARD_CHARYBDIS_CIRQUE_LEFT || BOARD_CHARYBDIS_CIRQUE_RIGHT)

  config ZMK_SLEEP
    default y

  config ZMK_SPLIT
    default y

  config BT_CTLR
    default BT

  if USB

  config USB_NRFX
      default y

  config USB_DEVICE_STACK
      default y

  endif # USB
endif
```

## boards/arm/charybdis_cirque/charybdis_cirque_defconfig
```kconfig
# 增加键盘的 BLE 无线电的发射功率，用解决延迟和左右通讯不佳的问题
# CONFIG_BT_CTLR_TX_PWR_PLUS_8=y
# CONFIG_MOUSE_LAYER_INDEX=4
# CONFIG_SCROLL_LAYER_INDEX=5

# CONFIG_ZMK_MOUSE=y
# CONFIG_ZMK_MOUSE_TICK_DURATION=5
# CONFIG_ZMK_MOUSE_WORK_QUEUE_DEDICATED=y

# CONFIG_ZMK_COMBO_MAX_PRESSED_COMBOS=15
# CONFIG_ZMK_COMBO_MAX_COMBOS_PER_KEY=15

# 是否开启蓝牙链接密码
# CONFIG_ZMK_BLE_PASSKEY_ENTRY=n

# 不活动 15 分钟后进入深度睡眠
CONFIG_ZMK_SLEEP=y
# 1800000 毫秒 = 30 分钟 * 60 秒 * 1000
CONFIG_ZMK_IDLE_SLEEP_TIMEOUT=9000000
# 进入空闲状态前的不活动毫秒数
CONFIG_ZMK_IDLE_TIMEOUT=15000

# 增加键盘消抖
# CONFIG_ZMK_KSCAN_DEBOUNCE_PRESS_MS=15
# CONFIG_ZMK_KSCAN_DEBOUNCE_RELEASE_MS=15

CONFIG_BT_DEVICE_NAME_MAX=32
CONFIG_BT_DEVICE_NAME="uniqueding-kb"

CONFIG_SPI=y
CONFIG_ZMK_USB=y
CONFIG_ZMK_MOUSE=y
CONFIG_RESET=y
CONFIG_GPIO=y
CONFIG_PINCTRL=y
CONFIG_ARM_MPU=y
CONFIG_SOC_SERIES_NRF52X=y
CONFIG_SOC_NRF52840_QIAA=y
CONFIG_CLOCK_CONTROL_NRF_K32SRC_XTAL=y
CONFIG_CLOCK_CONTROL_NRF_K32SRC_30PPM=y
CONFIG_SYS_CLOCK_HW_CYCLES_PER_SEC=125000000

# CONFIG_INPUT_PIXART_PMW3360=y
# CONFIG_INPUT_PIXART_PMW3360_USE_OWN_THREAD=y
# CONFIG_INPUT_PIXART_PMW3360_THREAD_PRIORITY=5
# CONFIG_INPUT_PIXART_PMW3360_THREAD_STACK_SIZE=768
```

## boards/arm/charybdis_cirque/charybdis_cirque_left_defconfig
```kconfig
CONFIG_BOARD_CHARYBDIS_CIRQUE_LEFT=y
# reset bt
# CONFIG_ZMK_SETTINGS_RESET_ON_START=y

# CONFIG_BT_CTLR_TX_PWR_PLUS_8=y
CONFIG_ZMK_BLE_PASSKEY_ENTRY=n

CONFIG_ZMK_SLEEP=y
# 1800000 毫秒 = 30 分钟 * 60 秒 * 1000
CONFIG_ZMK_IDLE_SLEEP_TIMEOUT=9000000
# 进入空闲状态前的不活动毫秒数
CONFIG_ZMK_IDLE_TIMEOUT=15000

# mouse
CONFIG_ZMK_MOUSE=y

CONFIG_GPIO=y
CONFIG_SPI=y
CONFIG_I2C=y
CONFIG_PINCTRL=y
CONFIG_ARM_MPU=y
CONFIG_ZMK_EXT_POWER=y

CONFIG_SOC_SERIES_NRF52X=y
CONFIG_SOC_NRF52840_QIAA=y

CONFIG_CLOCK_CONTROL_NRF_K32SRC_XTAL=y
CONFIG_CLOCK_CONTROL_NRF_K32SRC_30PPM=y

# flash
CONFIG_USE_DT_CODE_PARTITION=y
CONFIG_BUILD_OUTPUT_UF2=y
CONFIG_MPU_ALLOW_FLASH_WRITE=y
CONFIG_NVS=y
CONFIG_SETTINGS_NVS=y
CONFIG_FLASH=y
CONFIG_FLASH_PAGE_LAYOUT=y
CONFIG_FLASH_MAP=y
CONFIG_ZMK_SETTINGS_RESET_ON_START=y

CONFIG_ZMK_USB=n
CONFIG_ZMK_BLE=y
```

## boards/shields/charybdis_cirque/Kconfig.board
```kconfig
config BOARD_UNIQUEDING_KB
    bool "uniqueding_kb"
    select ZMK_MOUSE
    select pinctrl
    select INPUT
    select INPUT_PIXART_PMW3360
```

## boards/shields/charybdis_cirque/Kconfig.defconfig
```kconfig
if SHIELD_CHARYBDIS_CIRQUE_RIGHT

    config ZMK_KEYBOARD_NAME
        default "uniqueding-kb"

    config ZMK_SPLIT_BLE_ROLE_CENTRAL
        default y

endif

if SHIELD_CHARYBDIS_CIRQUE_LEFT
    config ZMK_KEYBOARD_NAME
        default "uniqueding-kbs"

endif

if SHIELD_CHARYBDIS_CIRQUE_LEFT || SHIELD_CHARYBDIS_CIRQUE_RIGHT

    config ZMK_SPLIT
        default y
    # config ZMK_USB
    #     default y

endif
```

## config/west.yml
```yaml
manifest:
  remotes:
    - name: zmkfirmware
      url-base: https://github.com/zmkfirmware
    - name: DoctorWangWang
      url-base: https://github.com/DoctorWangWang
    - name: urob
      url-base: https://github.com/urob
  projects:
    - name: zmk
      remote: zmkfirmware
      revision: v0.3
      import: app/west.yml
    - name: zmk-pmw3610-driver
      remote: DoctorWangWang
      revision: main
    - name: zmk-unicode
      remote: urob
      revision: 3e8ca744e5c3b6f430b3713f3e45b806ce89be7b
      
  self:
    path: config
```

## diagnostics/Kconfig
```kconfig
config CHARYBDIS_TRACKBALL_DIAGNOSTICS
	bool "Charybdis trackball USB/BLE input diagnostics"
	default n
	help
	  Adds low-overhead counters around the trackball input report and BLE
	  mouse-report producer paths. This is intended only for an explicit
	  diagnostic build with deferred logging enabled.
```
