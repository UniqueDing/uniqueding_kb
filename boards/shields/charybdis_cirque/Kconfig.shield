## boards/shields/charybdis_cirque/Kconfig.shield
```kconfig
config SHIELD_CHARYBDIS_CIRQUE_LEFT
    def_bool $(shields_list_contains,charybdis_cirque_left)

config SHIELD_CHARYBDIS_CIRQUE_RIGHT
    def_bool $(shields_list_contains,charybdis_cirque_right)
```
